## overlay/u-boot/board/radxa/rock5b-plus-rk3588/Kconfig
```kconfig
if TARGET_ROCK5B_PLUS_RK3588

config SYS_BOARD
	default "rock5b-plus-rk3588"

config SYS_VENDOR
	default "radxa"

config SYS_CONFIG_NAME
	default "rock5b-plus-rk3588"

endif
```
